## firmware/esp32_robot_idf/main/Kconfig.projbuild
```kconfig
menu "Balance Bot"

    config BALANCE_BOT_ENABLED
        bool "Enable balance bot (MPU6050 + PID)"
        default n
        help
            Adds IMU polling task, balance PID loop, and four BLE
            characteristics: BALANCE_CMD, BALANCE_PID, BALANCE_STATE,
            BALANCE_TARGET. The MOTOR_CHAR remains for status reads but
            the balance loop owns the actuators. Raw motor writes are
            overridden immediately by the 100 Hz control task.

    config BALANCE_BOT_I2C_PORT
        int "I2C port number (0 or 1)"
        depends on BALANCE_BOT_ENABLED
        default 0

    config BALANCE_BOT_I2C_SDA
        int "MPU6050 SDA GPIO"
        depends on BALANCE_BOT_ENABLED
        default 21

    config BALANCE_BOT_I2C_SCL
        int "MPU6050 SCL GPIO"
        depends on BALANCE_BOT_ENABLED
        default 22

    config BALANCE_BOT_IMU_ADDR
        hex "MPU6050 I2C address"
        depends on BALANCE_BOT_ENABLED
        default 0x68
        help
            0x68 when AD0 pin is LOW (default). 0x69 when AD0 is HIGH.

    config BALANCE_BOT_IMU_PITCH_INVERT
        bool "Invert pitch sign"
        depends on BALANCE_BOT_ENABLED
        default n
        help
            Enable if the robot leans forward but the pitch angle reads
            negative. Depends on how the MPU6050 is mounted on the frame.

endmenu
```

## firmware/esp32_robot_idf/sdkconfig.defaults
```kconfig
# Defaults applied on first build (idf.py reconfigure regenerates sdkconfig
# from these). Per-target overrides go in sdkconfig.defaults.<target>.

# WebRTC needs network + SCTP-friendly LWIP buffer sizes. Camera + NimBLE
# both want PSRAM. PSRAM mode is set per-target since classic ESP32 uses
# external SPI PSRAM and S3 uses Octal PSRAM.

# Logging — IDF v5.5 disabled colors by default; restore them so the
# recovery console renders I/W/E lines green/yellow/red.
CONFIG_LOG_DEFAULT_LEVEL_INFO=y
CONFIG_LOG_COLORS=y
CONFIG_BOOTLOADER_LOG_COLORS=y

# Bluetooth (NimBLE — matches Arduino stack)
CONFIG_BT_ENABLED=y
CONFIG_BT_NIMBLE_ENABLED=y
CONFIG_BT_CONTROLLER_ONLY=n
CONFIG_BT_BLUEDROID_ENABLED=n
# Single dashboard at a time. Pair-mailbox (Phase 2.F.2 BLE-relay) was
# why this was 4 and CCCDs were 32; with that gone, 2 connections is
# enough headroom for "operator's dashboard + a brief overlap during
# refresh". CCCDs = 2 conns × ~10 notify-capable chars, with margin.
CONFIG_BT_NIMBLE_MAX_CONNECTIONS=2
CONFIG_BT_NIMBLE_MAX_CCCDS=24

# Networking — bigger LWIP buffers help SCTP throughput on data channels.
CONFIG_LWIP_TCP_SND_BUF_DEFAULT=16384
CONFIG_LWIP_TCP_WND_DEFAULT=16384
# UDP send-side: libpeer's video-frame sends spammed "sendto: ENOMEM"
# on classic ESP32 with default WiFi TX buffers. Doubling the dynamic
# tx pool + raising the lwIP pbuf pool from 10→32 gives the WiFi TX
# path room to drain JPEG bursts without ENOMEM cascades. The video
# pump also chunks at ~900 B with a 2ms delay between chunks so the
# producer paces the consumer; this just adds headroom.
CONFIG_ESP_WIFI_DYNAMIC_TX_BUFFER_NUM=64
CONFIG_LWIP_UDP_RECVMBOX_SIZE=16
CONFIG_LWIP_PBUF_POOL_SIZE=32

# IPv6. On apartment-WiFi-as-a-service the IPv4 path goes through a
# centralized gateway that adds 100-300 ms to lateral traffic between
# residents — but the ISP delegates each device a global IPv6 address,
# and IPv6 packets between devices on the same /64 route directly via
# neighbor discovery. Enabling v6 lets WebRTC ICE pair host-v6↔host-v6,
# bypassing the slow v4 NAT entirely.
CONFIG_LWIP_IPV6=y
CONFIG_LWIP_IPV6_AUTOCONFIG=y
# DHCPv6 stateless. WhiteSky-Beckon (and likely other apt-WiFi) doesn't
# auto-send RAs to non-Apple clients via SLAAC, but does run a DHCPv6
# server. Phones get global v6 because Apple stacks do DHCPv6 by default.
CONFIG_LWIP_IPV6_DHCP6=y

# mbedTLS — esp_peer needs DTLS for the WebRTC handshake; HTTPS / cert
# bundle are no longer needed since the chip pulls ICE creds from the
# dashboard over BLE instead of fetching them itself.
CONFIG_MBEDTLS_SSL_PROTO_DTLS=y
CONFIG_MBEDTLS_HARDWARE_AES=y
CONFIG_MBEDTLS_HARDWARE_SHA=y

# Camera framebuffer in PSRAM
CONFIG_CAMERA_TASK_STACK_SIZE=4096

# ESP32-CAM modules often ship with Boya flash chips. Generic driver
# works but the Boya-specific one has tuned read/write timings.
CONFIG_SPI_FLASH_SUPPORT_BOYA_CHIP=y

# Partition table — OTA needs two app slots + factory.
CONFIG_PARTITION_TABLE_CUSTOM=y
CONFIG_PARTITION_TABLE_CUSTOM_FILENAME="partitions.csv"
```

## packages/sensors/Kconfig
```kconfig
menu "IMU filter"
    depends on BALANCE_BOT_ENABLED

    choice BALANCE_BOT_IMU_FILTER
        prompt "Pitch filter"
        default BALANCE_BOT_IMU_FILTER_COMPLEMENTARY

        config BALANCE_BOT_IMU_FILTER_COMPLEMENTARY
            bool "Complementary filter"
            help
                Fixed-ratio blend of gyro integration and accel-derived angle.
                Simple, zero-startup-cost, no tuning required.

        config BALANCE_BOT_IMU_FILTER_KALMAN
            bool "Kalman filter"
            help
                2-state discrete Kalman filter (angle + gyro-bias).
                Lower phase lag and online bias correction vs complementary.
                Requires tuning Q and R to match your hardware noise.
    endchoice

    config BALANCE_BOT_IMU_COMPLEMENTARY_ALPHA_PCT
        int "Alpha (x100, e.g. 98 = 0.98)"
        default 98
        range 90 99
        depends on BALANCE_BOT_IMU_FILTER_COMPLEMENTARY
        help
            Gyro trust ratio. At 100 Hz, 98 means accel corrects ~2% per tick.
            Lower values follow the accel faster but pass more accel noise.

    config BALANCE_BOT_IMU_KALMAN_Q_ANGLE_MILLI
        int "Q_angle (x1000, e.g. 1 = 0.001)"
        default 1
        range 1 1000
        depends on BALANCE_BOT_IMU_FILTER_KALMAN
        help
            Process noise for angle. Lower = smoother but slower to track
            true angle changes.

    config BALANCE_BOT_IMU_KALMAN_Q_BIAS_MILLI
        int "Q_bias (x1000, e.g. 3 = 0.003)"
        default 3
        range 1 100
        depends on BALANCE_BOT_IMU_FILTER_KALMAN
        help
            Process noise for gyro bias. Keep small — bias drifts slowly.

    config BALANCE_BOT_IMU_KALMAN_R_MEASURE_MILLI
        int "R_measure (x1000, e.g. 30 = 0.030)"
        default 30
        range 1 1000
        depends on BALANCE_BOT_IMU_FILTER_KALMAN
        help
            Measurement noise variance for accel angle. Increase if your
            accel is noisy or the bot vibrates significantly.

endmenu
```
